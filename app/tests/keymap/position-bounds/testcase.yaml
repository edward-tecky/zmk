## app/tests/keymap/position-bounds/testcase.yaml
```yaml
tests:
  zmk.keymap.position_bounds:
    platform_allow:
      - native_sim/native/64
    tags:
      - zmk
      - keymap
```

## app/tests/studio/gatt-rpc-rx/testcase.yaml
```yaml
tests:
  zmk.studio.gatt_rpc_rx:
    platform_allow:
      - native_sim
      - native_sim/native/64
    tags:
      - zmk
      - studio
```
